## main/Kconfig.projbuild
```kconfig
menu "MQTT and WiFi Configuration"
    config NV_CONFIG_INCLUDE
        bool "Use nanoview_config.h instead of below"        
        help
            Use nanoview_config.h for WiFi and MQTT config instead of below

    config ESP_WIFI_SSID
        string "WiFi SSID"
        default "myssid"
        help
            SSID (network name) for the example to connect to.

    config ESP_WIFI_PASSWORD
        string "WiFi Password"
        default "mypassword"
        help
            WiFi password (WPA or WPA2) for the example to use.

    config ESP_MAXIMUM_RETRY
        int "Maximum retry"
        default 5
        help
            Set the Maximum retry to avoid station reconnecting to the AP unlimited when the AP is really inexistent.

    config BROKER_URL
        string "Broker URL"
        default "mqtt://mqtt.eclipse.org"
        help
            URL of the broker to connect to
endmenu
```
